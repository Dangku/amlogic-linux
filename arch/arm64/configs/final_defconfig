## drivers/amlogic/Kconfig
```kconfig
# SPDX-License-Identifier: (GPL-2.0+ OR MIT)

config AMLOGIC_DRIVER
	bool "Amlogic Peripheral drivers"
	default n
	help
	  this option is provided for control amlogic
	  drivers, if you want to use amlogic driver
	  please open it.
	  Note: All amlogic driver should be placed in
	  directory drivers/amlogic/

config AMLOGIC_BREAK_GKI_20
	bool "Amlogic Break GKI 2.0"
	depends on AMLOGIC_BREAK_GKI
	default n
	help
	  this option is provide for control Break GKI 2.0,
	  if you want to break gki2.0 rule, should enable it,
	  all break gki2.0 modify should be depends on this option

if AMLOGIC_DRIVER
config AMLOGIC_BREAK_GKI
	bool "Amlogic Break GKI"
	default n
	help
	  this option is provide for control Break GKI,
	  if you want to debug driver temporarily, should enable it,
	  export function or variable with this config,
	  and the driver Kconfig depends on this option

config AMLOGIC_MODIFY
	bool "Amlogic modify for kernel code"
	default n
	help
	  This option is set up for AMLOGIC modify of standard
	  kernel source code. All modify of kernel standard code
	  should be wrapped by this config

config AMLOGIC_IN_KERNEL_MODULES
	bool "Amlogic Drivers in build or extra build"
	default n
	help
	  this option is provided for control amlogic
	  drivers in build or extra build, if you want
	  to in build, should enable; if want to extra
	  build, should disable

config AMLOGIC_KERNEL_VERSION
	int "Amlogic Kernel Version"
	default 13515
	help
	  kernel from android13-5.15
	  so the default value is 13515
	  the driver uses it to adapt different kernel versions

menu "Amlogic Device Drivers"

source "drivers/amlogic/tty/Kconfig"
source "drivers/amlogic/clk/Kconfig"
source "drivers/amlogic/secmon/Kconfig"
source "drivers/amlogic/drm/Kconfig"
source "drivers/amlogic/media/Kconfig"
source "drivers/amlogic/power/Kconfig"
source "drivers/amlogic/cpu_info/Kconfig"
source "drivers/amlogic/pm/Kconfig"
source "drivers/amlogic/gpio/Kconfig"
source "drivers/amlogic/input/Kconfig"
source "drivers/amlogic/i2c/Kconfig"
source "drivers/amlogic/spi/Kconfig"
source "drivers/amlogic/tee/Kconfig"
source "drivers/amlogic/aml_tee/Kconfig"
source "drivers/amlogic/gki_tool/Kconfig"
source "drivers/amlogic/pwm/Kconfig"
source "drivers/amlogic/cpufreq/Kconfig"
source "drivers/amlogic/efuse_unifykey/Kconfig"
source "drivers/amlogic/mailbox/Kconfig"
source "drivers/amlogic/jtag/Kconfig"
source "drivers/amlogic/watchdog/Kconfig"
source "drivers/amlogic/memory_ext/Kconfig"
source "drivers/amlogic/memory_debug/Kconfig"
source "drivers/amlogic/iio/Kconfig"
source "drivers/amlogic/char/Kconfig"
source "drivers/amlogic/soc_info/Kconfig"
source "drivers/amlogic/reset/Kconfig"
source "drivers/amlogic/rtc/Kconfig"
source "drivers/amlogic/irblaster/Kconfig"
source "drivers/amlogic/thermal/Kconfig"
source "drivers/amlogic/mmc/Kconfig"
source "drivers/amlogic/hifi4dsp/Kconfig"
source "drivers/amlogic/debug/Kconfig"
source "drivers/amlogic/camera/Kconfig"
source "drivers/amlogic/freertos/Kconfig"
source "drivers/amlogic/usb/Kconfig"
source "drivers/amlogic/crypto/Kconfig"
source "drivers/amlogic/wireless/Kconfig"
source "drivers/amlogic/net/Kconfig"
source "drivers/amlogic/mtd/spinand/Kconfig"
source "drivers/amlogic/mtd/nand/Kconfig"
source "drivers/amlogic/mtd/common/Kconfig"
source "drivers/amlogic/dvb/Kconfig"
source "drivers/amlogic/cpuidle/Kconfig"
source "drivers/amlogic/pci/Kconfig"
source "drivers/amlogic/led/Kconfig"
source "drivers/amlogic/dvb_ci/Kconfig"
source "drivers/amlogic/hwspinlock/Kconfig"
source "drivers/amlogic/android/Kconfig"
source "drivers/amlogic/yaffs2/Kconfig"
source "drivers/amlogic/audiobridge/Kconfig"
source "drivers/amlogic/algorithm/Kconfig"
source "drivers/amlogic/firmware/Kconfig"

endmenu
endif
```

## drivers/amlogic/char/Kconfig
```kconfig
# SPDX-License-Identifier: (GPL-2.0+ OR MIT)

menu "Character devices"

source "drivers/amlogic/char/hw_random/Kconfig"

endmenu
```

## drivers/amlogic/clk/Kconfig
```kconfig
# SPDX-License-Identifier: (GPL-2.0+ OR MIT)

source "drivers/amlogic/clk/meson/Kconfig"
```

## drivers/amlogic/gpio/Kconfig
```kconfig
# SPDX-License-Identifier: (GPL-2.0+ OR MIT)

menuconfig AMLOGIC_GPIO
	tristate "Amlogic gpio support"
	default n
	help
	  Say Y here to get to see options for gpio drivers.
	  This option alone does not add any kernel code.

	  If you say N, all options in this submenu will be
	  skipped and disabled.

if AMLOGIC_GPIO

config AMLOGIC_GPIOLIB
	bool "Amlogic gpiolib expand"
	depends on AMLOGIC_GPIO
	depends on GPIOLIB
	default n
	help
	  Say Y here if you want to use the
	  amlogic gpiolib expand.

source "drivers/amlogic/gpio/irqchip/Kconfig"
source "drivers/amlogic/gpio/pinctrl/Kconfig"

endif # AMLOGIC_GPIO
```

## drivers/amlogic/i2c/Kconfig
```kconfig
# SPDX-License-Identifier: (GPL-2.0+ OR MIT)

source "drivers/amlogic/i2c/busses/Kconfig"
```

## drivers/amlogic/iio/Kconfig
```kconfig
# SPDX-License-Identifier: (GPL-2.0+ OR MIT)

if IIO

source "drivers/amlogic/iio/adc/Kconfig"

endif # IIO
```

## drivers/amlogic/input/Kconfig
```kconfig
# SPDX-License-Identifier: (GPL-2.0+ OR MIT)

menuconfig AMLOGIC_INPUT
	tristate "Amlogic input devices support"
	default n
	help
	  Say Y here to enable Amlogic input
	  devices. Include keyboard, third part
	  touchscreen, sensor, gpio-key, adc-key,
	  ir remote control etc.

if AMLOGIC_INPUT
source "drivers/amlogic/input/keyboard/Kconfig"
source "drivers/amlogic/input/ir/Kconfig"
endif
```

## drivers/amlogic/memory_debug/reg_access/Kconfig
```kconfig
# SPDX-License-Identifier: (GPL-2.0+ OR MIT)

config AMLOGIC_REG_ACCESS
    bool "Amlogic register access from userspace support"
    depends on AMLOGIC_MEMORY_DEBUG
    default n
    help
      This is the debug interface for resister and memory access from user space
```

## drivers/amlogic/mmc/Kconfig
```kconfig
# SPDX-License-Identifier: (GPL-2.0+ OR MIT)

source "drivers/amlogic/mmc/host/Kconfig"
```

## drivers/amlogic/net/Kconfig
```kconfig
# SPDX-License-Identifier: (GPL-2.0+ OR MIT)

source "drivers/amlogic/net/mdio/Kconfig"
source "drivers/amlogic/net/phy/Kconfig"
source "drivers/amlogic/net/ethernet/Kconfig"
```

## drivers/amlogic/net/ethernet/stmicro/Kconfig
```kconfig
# SPDX-License-Identifier: (GPL-2.0+ OR MIT)

source "drivers/amlogic/net/ethernet/stmicro/stmmac/Kconfig"
```

## drivers/amlogic/pci/Kconfig
```kconfig
# SPDX-License-Identifier: (GPL-2.0+ OR MIT)

menu "Amlogic PCI Support"

config AMLOGIC_PCI_HOST
	bool "Amlogic PCI controller support"
	default n
	help
	  Amlogic PCI controller drivers support

config AMLOGIC_PCI_EP
	bool "Amlogic PCI endpoint support"
	default n
	help
	  Amlogic PCI endpoint drivers support

source "drivers/amlogic/pci/controller/Kconfig"

endmenu
```

## drivers/amlogic/rtc/Kconfig
```kconfig
# SPDX-License-Identifier: (GPL-2.0+ OR MIT)

config AMLOGIC_RTC_DRV_MESON_VRTC
	bool "Amlogic Meson Virtual RTC"
	default n
	help
	  If you say yes here you will get support for the
	  Virtual RTC of Amlogic SoCs.

	  This driver can also be built as a module. If so, the module
	  will be called rtc-meson-vrtc.

config AMLOGIC_MESON_RTC
	bool "Amlogic Meson RTC driver"
	default n
	help
	  This is the Amlogic rtc driver.

	  This driver can also be built as a module. If so, the module
	  will be called meson-rtc.
```

## drivers/amlogic/tty/Kconfig
```kconfig
# SPDX-License-Identifier: (GPL-2.0+ OR MIT)

source "drivers/amlogic/tty/serial/Kconfig"
```

## drivers/amlogic/wireless/Kconfig
```kconfig
# SPDX-License-Identifier: (GPL-2.0+ OR MIT)

menuconfig AMLOGIC_WIRELESS
	tristate "Amlogic wifi and bluetooth support"
	default n
	help
	  Say y here to get to see options for wireless drivers
	  This option alone does not add any kernel code.

          If you say N, all options in this submenu will be
          skipped and disabled.

if AMLOGIC_WIRELESS
source "drivers/amlogic/wireless/bluetooth/Kconfig"
source "drivers/amlogic/wireless/wifi/Kconfig"
endif
```

## samples/debug_file_test/Kconfig
```kconfig
# SPDX-License-Identifier: (GPL-2.0+ OR MIT)

source "samples/debug_file_test/drivers_test/Kconfig"
```
