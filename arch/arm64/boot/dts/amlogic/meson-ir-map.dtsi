// SPDX-License-Identifier: (GPL-2.0+ OR MIT)
/*
 * Copyright (c) 2019 Amlogic, Inc. All rights reserved.
 */

/ {

	custom_maps: custom_maps {
		mapnum = <1>;
		map0 = <&map_0>;
                map_0: map_0{
                        mapname = "amlogic-remote-bananapi";
                        customcode = <0xfe01>;
                        release_delay = <80>;
                        vendor = <0x0001>;
                        product = <0x0001>;
                        version = <0x0100>;
                        size  = <13>;
                        keymap = <REMOTE_KEY(0x00, KEY_POWER)
				REMOTE_KEY(0x01, KEY_MENU)
				REMOTE_KEY(0x09, KEY_HOME)
				REMOTE_KEY(0x02, KEY_LEFT)
				REMOTE_KEY(0x0a, KEY_RIGHT)
				REMOTE_KEY(0x05, KEY_UP)
				REMOTE_KEY(0x04, KEY_DOWN)
				REMOTE_KEY(0x06, KEY_ENTER)
				REMOTE_KEY(0x03, KEY_VOLUMEDOWN)
				REMOTE_KEY(0x0b, KEY_VOLUMEUP)
				REMOTE_KEY(0x40, KEY_BACK)
				REMOTE_KEY(0x48, KEY_PLAYPAUSE)
				REMOTE_KEY(0x44, KEY_MUTE)>;
                };
	};
};
