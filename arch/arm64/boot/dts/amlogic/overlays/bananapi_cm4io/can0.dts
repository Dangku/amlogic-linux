/dts-v1/;
/plugin/;

#include <dt-bindings/gpio/meson-t7-gpio.h>
#include <dt-bindings/gpio/gpio.h>

/ {
	fragment@0 {
		target-path = "/";
		__overlay__ {
			can0_clk: can0-clk {
				compatible = "fixed-clock";
				clock-frequency = <16000000>;
				clock-output-names = "can0_clk";
				#clock-cells = <0>;
			};
		};
	};

	fragment@1 {
		target = <&spicc2>;
		__overlay__ {
			status = "okay";
			#address-cells = <1>;
			#size-cells = <0>;

			can0: can@0 {
				compatible = "microchip,mcp2515";
				reg = <0>;
				clocks = <&can0_clk>;
				gpio-irq = <&gpio GPIOY_12 GPIO_ACTIVE_LOW>;
				spi-max-frequency = <10000000>;
				status = "okay";
			};
		};
	};
};
