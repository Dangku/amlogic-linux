/dts-v1/;
/plugin/;

/ {
	fragment@0 {
		// i2c2 aliased with i2c0.
		// This activates i2c2 but it will be named as i2c0 on the userspace.
		target = <&i2c2>;

		__overlay__ {
			status = "okay";

			at24@50 {
				compatible = "at24,24c256";
				reg = <0x50>;
				pagesize = <64>;
				//read-only;
			};
		};
	};
};
