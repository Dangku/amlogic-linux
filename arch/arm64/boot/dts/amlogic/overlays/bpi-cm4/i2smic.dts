/dts-v1/;
/plugin/;

/ {
	fragment@0 {
		target = <&aml_tdmb>;
		__overlay__ {
			status = "okay";
			pinctrl-names = "tdm_pins";
			pinctrl-0 = <&tdmb_mclk &tdmout_b &tdmin_b>;
		};
	};


	fragment@1 {
		target = <&tdmbcodec>;

		__overlay__ {
			sound-dai = <&dummy_codec &dummy_codec>;
		};
	};
};
