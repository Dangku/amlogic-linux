/dts-v1/;
/plugin/;

/ {
	fragment@0 {
		target = <&aml_tdmc>;
		__overlay__ {
			status = "okay";
			pinctrl-names = "tdm_pins";
			pinctrl-0 = <&tdmc_mclk &tdmout_c &tdmin_c>;
		};
	};


	fragment@1 {
		target = <&tdmccodec>;

		__overlay__ {
			sound-dai = <&dummy_codec &dummy_codec>;
		};
	};
};
