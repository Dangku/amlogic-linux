/dts-v1/;
/plugin/;

/ {
	fragment@0 {
		target = <&uart_D>; /* /dev/ttyS3 */

		__overlay__ {
			pinctrl-0 = <&d_uart_pins2>; /* UART_D, GPIOY_12, GPIOY_13 */
			pinctrl-names = "default";
			status = "okay";
		};
	};
};
