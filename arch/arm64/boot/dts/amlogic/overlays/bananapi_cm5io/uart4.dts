/dts-v1/;
/plugin/;

/ {
	fragment@0 {
		target = <&uart_E>; /* /dev/ttyS4 */

		__overlay__ {
			pinctrl-0 = <&e_uart_pins>; /* UART_E, GPIOY_6, GPIOY_7 */
			pinctrl-names = "default";
			status = "okay";
		};
	};
};
