/dts-v1/;
/plugin/;

#include <dt-bindings/pwm/meson.h>
#include <dt-bindings/pwm/pwm.h>

/{
	fragment@0 {
		target = <&pwmao_gh>;

		__overlay__ {
			status = "okay";
		};
	};

	fragment@1 {
		target-path = "/";

		__overlay__ {
			beeper: beeper {
				compatible = "pwm-beeper";
				pwms = <&pwmao_gh MESON_PWM_1 1000000 0>;
				status = "okay";
			};
		};
	};
};
