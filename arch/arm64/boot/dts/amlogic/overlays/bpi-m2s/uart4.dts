/dts-v1/;
/plugin/;

/ {
	fragment@0 {
		// uart_AO_B driver create ttyS4 on the userspace.
		target = <&uart_AO_B>;

		__overlay__ {
			status = "okay";
			pinctrl-names = "default";
			pinctrl-0 = <&ao_b_uart_pins2>;
		};
	};
};
