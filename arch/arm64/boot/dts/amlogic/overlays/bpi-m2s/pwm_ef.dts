/dts-v1/;
/plugin/;

/ {
	fragment@0 {
		target = <&pwm_ef>;

		__overlay__ {
			status = "okay";
			pinctrl-names = "default";
			pinctrl-0 = <&pwm_e_pins &pwm_f_pins1>; /* GPIOX_16,GPIOX_7 */
		};
	};
};
